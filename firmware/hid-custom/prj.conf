## CMakeLists.txt
```
# SPDX-License-Identifier: Apache-2.0

cmake_minimum_required(VERSION 3.20.0)
find_package(Zephyr REQUIRED HINTS $ENV{ZEPHYR_BASE})
project(hid-custom)

include(${ZEPHYR_BASE}/samples/subsys/usb/common/common.cmake)
target_sources(app PRIVATE 
    src/main.c
    src/controller_esb.c
    src/usb_hid_composite.c
)
```

## prj.conf
```kconfig
CONFIG_USB_DEVICE_STACK_NEXT=y
CONFIG_USB_DEVICE_STACK=n
CONFIG_USBD_HID_SUPPORT=y

CONFIG_LOG=n
CONFIG_USBD_LOG_LEVEL_WRN=n
CONFIG_USBD_HID_LOG_LEVEL_WRN=n
CONFIG_UDC_DRIVER_LOG_LEVEL_WRN=n
CONFIG_SAMPLE_USBD_PID=0x05C4

CONFIG_SAMPLE_USBD_MANUFACTURER="Sony Computer Entertainment"
CONFIG_SAMPLE_USBD_PRODUCT="Wireless Controller"
CONFIG_SAMPLE_USBD_MAX_POWER=250
CONFIG_SAMPLE_USBD_20_EXTENSION_DESC=y

CONFIG_GPIO=y
CONFIG_INPUT=y

# Enhanced ShockBurst configuration
CONFIG_ESB=y

# Increase main thread stack size for dual controller processing
CONFIG_MAIN_STACK_SIZE=8192

# High priority system workqueue to prevent ESB blocking
CONFIG_SYSTEM_WORKQUEUE_PRIORITY=-1
CONFIG_MAIN_THREAD_PRIORITY=7
```

## xiao_ble_nrf52840.overlay
```dts
/ {
	hid_dev_0: hid_dev_0 {
		compatible = "zephyr,hid-device";
		interface-name = "HID0";
		protocol-code = "none";
		in-polling-period-us = <4000>;
		in-report-size = <64>;
	};
};
```

## src/main.c
```c
#include <stdint.h>
#include <string.h>
#include <zephyr/kernel.h>
#include <zephyr/device.h>
#include <zephyr/drivers/gpio.h>
#include "controller_esb.h"
#include "usb_hid_composite.h"

#include <zephyr/logging/log.h>
LOG_MODULE_REGISTER(main, LOG_LEVEL_INF);

bool left_trackpad_pressed = false;
bool right_trackpad_pressed = false;

bool left_mode_pressed = false;
bool right_mode_pressed = false;

static const struct gpio_dt_spec led0 = GPIO_DT_SPEC_GET(DT_ALIAS(led0), gpios);
// Helper function to map a value from one range to another
long map(long x, long in_min, long in_max, long out_min, long out_max)
{
    return (x - in_min) * (out_max - out_min) / (in_max - in_min) + out_min;
}

// Convert controller data to HID reports (using separated controller states)
static void process_controller_data(const struct device *hid_dev)
{
    uint32_t func_start = k_uptime_get_32();
    
    // Get SEPARATE controller states - no more shared state corruption!
    simple_controller_state_t *left_controller = controller_esb_get_left_state();
    simple_controller_state_t *right_controller = controller_esb_get_right_state();

    // Static variables to hold complete state
    static uint8_t dpad = 8;
    static uint8_t buttons1 = 0, buttons2 = 0;
    static uint8_t left_x = 128, left_y = 128;
    static uint8_t right_x = 128, right_y = 128;
    static uint8_t left_trigger = 0, right_trigger = 0;
    static bool touch1_active = false;
    static bool touch2_active = false;
    static uint16_t touch1_x = 0, touch1_y = 0;
    static uint16_t touch2_x = 0, touch2_y = 0;
    static int16_t accel_x = 0, accel_y = 0, accel_z = 0;
    static int16_t gyro_x = 0, gyro_y = 0, gyro_z = 0;

    static uint16_t raw_touch2_x = 0;
    static uint16_t raw_touch2_y = 0;

    static uint16_t last_touch2_x = 0, last_touch2_y = 0;
    static bool last_touch2_active = false;
    static float interp_factor = 0.7f; // Adjust for smoothness

    static uint16_t raw_touch_x = 0;
    static uint16_t raw_touch_y = 0;

    // Static variables for interpolation
    static uint16_t last_touch_x = 0, last_touch_y = 0;
    static bool last_touch_active = false;

    // Process LEFT controller data independently
    if (left_controller->data_received)
    {
        // Left controller data
        left_x = (uint8_t)(left_controller->stickX + 128);
        left_y = (uint8_t)(left_controller->stickY + 128);
        left_trigger = left_controller->trigger;

        // Touchpad from left controller
        touch2_active = (left_controller->padX != 0 || left_controller->padY != 0);

        // Raw trackpad values after mapping
        raw_touch2_x = touch2_active ? (map(left_controller->padY, 0, 1023, 959, 0)) : 0;
        raw_touch2_y = touch2_active ? (map(left_controller->padX, 0, 1023, 0, 942)) : 0;

        // Left controller Dpad processing
        if ((left_controller->buttons & 0x08) && !(left_controller->buttons & 0x04) && !(left_controller->buttons & 0x02) && !(left_controller->buttons & 0x01)) // just down
        {
            dpad = 4; // Down
        }
        if (!(left_controller->buttons & 0x08) && (left_controller->buttons & 0x04) && !(left_controller->buttons & 0x02) && !(left_controller->buttons & 0x01)) // just right
        {
            dpad = 2; // Right
        }
        if (!(left_controller->buttons & 0x08) && !(left_controller->buttons & 0x04) && (left_controller->buttons & 0x02) && !(left_controller->buttons & 0x01)) // just left
        {
            dpad = 6; // Left
        }
        if (!(left_controller->buttons & 0x08) && !(left_controller->buttons & 0x04) && !(left_controller->buttons & 0x02) && (left_controller->buttons & 0x01)) // just up
        {
            dpad = 0; // Up
        }
        if ((left_controller->buttons & 0x08) && (left_controller->buttons & 0x04) && !(left_controller->buttons & 0x02) && !(left_controller->buttons & 0x01)) // down right
        {
            dpad = 3; // Down Right
        }
        if (!(left_controller->buttons & 0x08) && (left_controller->buttons & 0x04) && !(left_controller->buttons & 0x02) && (left_controller->buttons & 0x01)) // right up
        {
            dpad = 1; // Right Up
        }
        if ((left_controller->buttons & 0x08) && !(left_controller->buttons & 0x04) && (left_controller->buttons & 0x02) && !(left_controller->buttons & 0x01)) // down left
        {
            dpad = 5; // Left Down
        }
        if (!(left_controller->buttons & 0x08) && !(left_controller->buttons & 0x04) && (left_controller->buttons & 0x02) && (left_controller->buttons & 0x01)) // left up
        {
            dpad = 7; // Up Left
        }
        if (!(left_controller->buttons & 0x08) && !(left_controller->buttons & 0x04) && !(left_controller->buttons & 0x02) && !(left_controller->buttons & 0x01)) // neutral
        {
            dpad = 8; // neutral
        }

        // Left controller buttons
        if (left_controller->buttons & 0x10 || left_controller->flags & 0x01) // 0x01 is P5 just hard coding it for now
        {
            buttons1 |= (1 << 4); // Bumper
        }
        else
        {
            buttons1 &= ~(1 << 4); // Bumper
        }

        if (left_controller->buttons & 0x40)
        {
            buttons2 |= (1 << 5); // Trackpad Click
            left_trackpad_pressed = true;
        }
        else
        {
            left_trackpad_pressed = false;
        }

        if (left_controller->buttons & 0x20 || left_controller->flags & 0x02) // 0x02 is P4 just hard coding it for now
        {
            buttons2 |= (1 << 2); // Stick Click
        }
        else
        {
            buttons2 &= ~(1 << 2); // Stick Click
        }

        if (left_controller->buttons & 0x80)
        {
            buttons2 |= (1 << 0); // Select
        }
        else
        {
            buttons2 &= ~(1 << 0); // Select
        }

        if (left_controller->flags & 0x40)
        {
            buttons2 |= (1 << 4); // PS button
            left_mode_pressed = true;
        }
        else
        {
            left_mode_pressed = false;
        }
    }

    // Process RIGHT controller data independently
    if (right_controller->data_received)
    {
        // Right controller data
        right_x = (uint8_t)(right_controller->stickX + 128);
        right_y = (uint8_t)(right_controller->stickY + 128);
        right_trigger = right_controller->trigger;

        // IMU from right controller only
        accel_x = right_controller->accelX;
        accel_y = right_controller->accelY;
        accel_z = right_controller->accelZ;
        gyro_x = right_controller->gyroX;
        gyro_y = right_controller->gyroY;
        gyro_z = right_controller->gyroZ;

        gyro_y = -gyro_y;
        accel_y = -accel_y;

        // Touchpad from right controller
        touch1_active = (right_controller->padX != 0 || right_controller->padY != 0);
        
        // Raw trackpad values after mapping
        raw_touch_x = touch1_active ? (map(right_controller->padY, 0, 1023, 0, 959) + 959) : 0;
        raw_touch_y = touch1_active ? (map(right_controller->padX, 0, 1023, 942, 0)) : 0;

        // Right controller buttons
        if (right_controller->buttons & 0x01)
        {
            buttons1 |= (1 << 3); // Y
        }
        else
        {
            buttons1 &= ~(1 << 3); // Y
        }

        if (right_controller->buttons & 0x02)
        {
            buttons1 |= (1 << 0); // X
        }
        else
        {
            buttons1 &= ~(1 << 0); // X
        }

        if (right_controller->buttons & 0x04)
        {
            buttons1 |= (1 << 2); // B
        }
        else
        {
            buttons1 &= ~(1 << 2); // B
        }

        if (right_controller->buttons & 0x08 || right_controller->flags & 0x01) // 0x01 is P5 just hard coding it for now
        {
            buttons1 |= (1 << 1); // A
        }
        else
        {
            buttons1 &= ~(1 << 1); // A
        }

        if (right_controller->buttons & 0x10)
        {
            buttons1 |= (1 << 5); // Bumper
        }
        else
        {
            buttons1 &= ~(1 << 5); // Bumper
        }

        if (right_controller->buttons & 0x20 || right_controller->flags & 0x02) // 0x02 is P4 just hard coding it for now
        {
            buttons2 |= (1 << 3); // Stick Click
        }
        else
        {
            buttons2 &= ~(1 << 3); // Stick Click
        }

        if (right_controller->buttons & 0x40)
        {
            buttons2 |= (1 << 5); // Trackpad Click
            right_trackpad_pressed = true;
        }
        else
        {
            right_trackpad_pressed = false;
        }

        if (right_controller->buttons & 0x80)
        {
            buttons2 |= (1 << 1); // Start
        }
        else
        {
            buttons2 &= ~(1 << 1); // Start
        }

        if (right_controller->flags & 0x40)
        {
            buttons2 |= (1 << 4); // Guide button
            buttons1 |= (1 << 1); // A
            right_mode_pressed = true;
        }
        else
        {
            right_mode_pressed = false;
        }
    }

    // Handle trackpad and mode button combinations
    if (!left_trackpad_pressed && !right_trackpad_pressed)
    {
        buttons2 &= ~(1 << 5);
    }

    if (!left_mode_pressed && !right_mode_pressed)
    {
        buttons2 &= ~(1 << 4); // Clear PS/Guide button
    }

    if (touch1_active && last_touch_active)
    {
        // Interpolate between last and current position
        touch1_x = (uint16_t)(last_touch_x * interp_factor + raw_touch_x * (1.0f - interp_factor));
        touch1_y = (uint16_t)(last_touch_y * interp_factor + raw_touch_y * (1.0f - interp_factor));
    }
    else
    {
        // First touch or touch just started
        touch1_x = raw_touch_x;
        touch1_y = raw_touch_y;
    }

    // Store for next frame
    last_touch_x = touch1_x;
    last_touch_y = touch1_y;
    last_touch_active = touch1_active;

    if (touch2_active && last_touch2_active)
    {
        // Interpolate between last and current position
        touch2_x = (uint16_t)(last_touch2_x * interp_factor + raw_touch2_x * (1.0f - interp_factor));
        touch2_y = (uint16_t)(last_touch2_y * interp_factor + raw_touch2_y * (1.0f - interp_factor));
    }
    else
    {
        // First touch or touch just started
        touch2_x = raw_touch2_x;
        touch2_y = raw_touch2_y;
    }

    // Store for next frame
    last_touch2_x = touch2_x;
    last_touch2_y = touch2_y;
    last_touch2_active = touch2_active;
    // With interp(end)

    // Send the report (same as before)
    usb_hid_send_ds4_report_with_touchpad_and_imu(hid_dev, dpad, buttons1, buttons2,
                                                  left_x, left_y, right_x, right_y,
                                                  left_trigger, right_trigger,
                                                  touch1_active, touch1_x, touch1_y,
                                                  touch2_active, touch2_x, touch2_y,
                                                  accel_x, accel_y, accel_z,
                                                  gyro_x, gyro_y, gyro_z);
                                                  
    // Log function timing if it's slow
    uint32_t func_time = k_uptime_get_32() - func_start;
    if (func_time > 5) { // Only warn if function takes over 5ms (was 1ms)
        LOG_WRN("Slow process_controller_data: %dms", func_time);
    }
}

int main(void)
{
    const struct device *hid_dev;
    int ret;

    if (!gpio_is_ready_dt(&led0))
    {
        // LOG_ERR("LED device %s is not ready", led0.port->name);
        return 0;
    }

    ret = gpio_pin_configure_dt(&led0, GPIO_OUTPUT);
    if (ret < 0)
    {
        // LOG_ERR("Failed to configure the LED pin, error: %d", ret);
        return 0;
    }

    // Initialize USB HID composite device
    ret = usb_hid_composite_init();
    if (ret != 0)
    {
        // LOG_ERR("Failed to initialize USB HID");
        return 0;
    }

    // Get the HID device handle
    hid_dev = usb_hid_composite_get_device();
    if (hid_dev == NULL)
    {
        // LOG_ERR("Failed to get USB HID device");
        return 0;
    }

    // Initialize ESB
    ret = controller_esb_init();
    if (ret != 0)
    {
        // LOG_ERR("Failed to initialize ESB");
        return 0;
    }

    // LOG_INF("Waiting for radio to fully initialize...");
    k_sleep(K_MSEC(500));
    // LOG_INF("Starting ESB ping loop");

    // Main loop - poll controllers and process responses
    uint32_t heartbeat_timer = 0;
    uint32_t last_report_time = 0;
    uint32_t last_ping_time = 0;

    while (true)
    {
        uint32_t now = k_uptime_get_32();
        uint32_t loop_start = now;

        if (now - last_report_time >= 4)
        { // 250Hz (4ms)
            last_report_time = now;
        //     uint32_t process_start = k_uptime_get_32();
            process_controller_data(hid_dev);
        //     uint32_t process_end = k_uptime_get_32();
            
            // Log if processing takes too long
            // uint32_t process_time = process_end - process_start;
            // if (process_time > 5) { // Only warn if processing takes over 5ms (was 2ms)
            //     LOG_WRN("Long processing time: %dms", process_time);
            // }
        }

        // Log if entire loop iteration takes too long
        uint32_t loop_end = k_uptime_get_32();
        uint32_t loop_time = loop_end - loop_start;
        if (loop_time > 10) { // Only warn if loop takes over 10ms (was 3ms)
            LOG_WRN("Long loop time: %dms", loop_time);
        }

        // Small delay to prevent overwhelming the system
        k_sleep(K_USEC(250));
    }
    return 0;
}
```

## src/controller_esb.c
```c
#include "controller_esb.h"
#include <zephyr/drivers/gpio.h>
#include <zephyr/drivers/clock_control.h>
#include <zephyr/drivers/clock_control/nrf_clock_control.h>
#include <zephyr/logging/log.h>

LOG_MODULE_REGISTER(controller_esb, LOG_LEVEL_INF);

// ESB data structures
static struct esb_payload rx_payload;

// SEPARATE CONTROLLER STATES - prevents data corruption between controllers
static simple_controller_state_t left_controller_state = {0};   // Index 1 (flags & 0x80 = true)
static simple_controller_state_t right_controller_state = {0};  // Index 0 (flags & 0x80 = false)

// LED for debug feedback
static const struct gpio_dt_spec led0 = GPIO_DT_SPEC_GET(DT_ALIAS(led0), gpios);

// Timing tracking for packet logging
static uint32_t last_packet_time = 0;

// ACK payload timing control variables
static uint8_t sequence_counter = 0;
static uint32_t last_tx_time[2] = {0, 0};  // Separate timing for each controller: [0]=right, [1]=left
static uint32_t last_any_rx_time = 0;      // Track most recent packet from ANY controller for collision detection
static const uint16_t BASE_INTERVAL_MS = 4;  // 4ms intervals for stable performance

// ESB event handler for ACK-based reception
static void simple_esb_event_handler(struct esb_evt const *event)
{
    // Always log events to debug communication
    // LOG_INF("DONGLE ESB EVENT: %d", event->evt_id);

    switch (event->evt_id)
    {
    case ESB_EVENT_RX_RECEIVED:
        // LOG_INF("RX RECEIVED - got controller data");
        
        uint32_t rx_start = k_uptime_get_32();
        static uint32_t last_rx_process_time = 0;
        
        // Get the received data
        if (esb_read_rx_payload(&rx_payload) == 0)
        {
            // Filter out spurious packets - we only want controller data
            if (rx_payload.length == sizeof(controller_data_t))
            {
                // LOG_INF("Valid controller data - length: %d, pipe: %d", rx_payload.length, rx_payload.pipe);
                // Parse the controller data
                controller_data_t *data = (controller_data_t *)rx_payload.data;

                // Calculate timing and determine controller half
                uint32_t current_time = k_uptime_get_32();
                uint32_t time_diff = current_time - last_packet_time;
                bool is_left = (data->flags & 0x80) != 0;
                uint8_t controller_id = is_left ? 1 : 0;

                // Calculate gap since ANY controller packet for collision detection (BEFORE updating timing)
                uint32_t gap_since_any = (last_any_rx_time == 0) ? 0 : (current_time - last_any_rx_time);

                // Log only problematic timing patterns to reduce logging overhead
                if (last_packet_time != 0 && time_diff < 2)
                {
                    LOG_WRN("COLLISION: %s controller - %dms gap (too close!)",
                            is_left ? "LEFT" : "RIGHT", time_diff);
                    
                    // Also log per-controller timing for collisions
                    uint32_t controller_gap = (last_tx_time[controller_id] == 0) ? 0 : 
                                             (current_time - last_tx_time[controller_id]);
                    LOG_WRN("    Controller gap: %dms since last from THIS controller", controller_gap);
                }

                // Update timing variables AFTER calculating gaps
                last_packet_time = current_time;
                last_any_rx_time = current_time;

                // IMMEDIATE CONTROLLER ROUTING - store data in correct controller array immediately
                // This prevents data corruption when both controllers transmit rapidly
                simple_controller_state_t *target_controller = is_left ? &left_controller_state : &right_controller_state;
                
                target_controller->flags = data->flags;
                target_controller->trigger = data->trigger;
                target_controller->stickX = data->stickX;
                target_controller->stickY = data->stickY;
                target_controller->padX = data->padX;
                target_controller->padY = data->padY;
                target_controller->buttons = data->buttons;
                target_controller->accelX = data->accelX;
                target_controller->accelY = data->accelY;
                target_controller->accelZ = data->accelZ;
                target_controller->gyroX = data->gyroX;
                target_controller->gyroY = data->gyroY;
                target_controller->gyroZ = data->gyroZ;
                target_controller->data_received = true;
                target_controller->last_ping_time = current_time;

                // Track severe delays that indicate controller-side issues
                if (time_diff > 50) {
                    LOG_ERR("SEVERE DELAY: %dms gap from %s controller - likely controller freeze", 
                            time_diff, is_left ? "LEFT" : "RIGHT");
                }

                // Create ACK payload with timing control + rumble (lean 8-byte design)
                ack_timing_data_t ack_data = {
                    .next_delay_ms = 0,        // Will calculate below
                    .sequence_num = sequence_counter++,
                    .rumble_data = 0x00,       // No rumble for now: left=0, right=0 
                    .dongle_timestamp = current_time
                };
                
                // Staggered timing to prevent packet collisions
                // Both controllers use the same base interval
                uint32_t base_delay = BASE_INTERVAL_MS;  // 4ms for both
                
                // Check if we need collision avoidance padding
                // If this packet arrived ≤1ms after the last packet from ANY controller, add 1ms padding
                bool need_collision_padding = false;
                if (gap_since_any > 0 && gap_since_any <= 1) {
                    need_collision_padding = true;
                    LOG_WRN("COLLISION DETECTED: Adding 1ms padding to %s controller (gap was %dms)", 
                            is_left ? "LEFT" : "RIGHT", gap_since_any);
                }
                
                // Set the delay: base interval + collision padding if needed
                ack_data.next_delay_ms = base_delay + (need_collision_padding ? 1 : 0);
                
                // Log what timing we're actually sending to controllers - every 10th packet to reduce spam
                static uint32_t log_counter = 0;
                if (++log_counter % 10 == 0) {
                    uint32_t time_since_last = (last_tx_time[controller_id] == 0) ? 0 : (current_time - last_tx_time[controller_id]);
                    LOG_WRN("%s controller: base=%dms, since_last=%dms, sending_delay=%dms%s",
                            is_left ? "LEFT" : "RIGHT", base_delay, time_since_last, ack_data.next_delay_ms,
                            need_collision_padding ? " (PADDED)" : "");
                }
                
                // Update last transmission time tracking (per-controller)
                last_tx_time[controller_id] = current_time;
                
                // NOTE: last_any_rx_time already updated above after gap calculation
                
                // Queue ACK payload using Nordic's approach - this goes into TX FIFO
                // and will be attached to the ACK for the NEXT packet received on this pipe
                struct esb_payload ack_tx_payload = {0};
                ack_tx_payload.pipe = rx_payload.pipe;        // CRUCIAL - same pipe as RX
                ack_tx_payload.length = sizeof(ack_timing_data_t); // 8 bytes
                memcpy(ack_tx_payload.data, &ack_data, ack_tx_payload.length);
                
                // Queue it - this attaches to the next ACK on this pipe
                int result = esb_write_payload(&ack_tx_payload);
                if (result != 0) {
                    LOG_WRN("Failed to queue ACK payload: %d", result);
                } else {
                    // DEBUG: Let's verify we're actually sending ACK payloads
                    static uint32_t ack_counter = 0;
                    if (++ack_counter % 20 == 0) {
                        LOG_INF("ACK payload sent: delay=%dms, pipe=%d, seq=%d", 
                               ack_data.next_delay_ms, rx_payload.pipe, ack_data.sequence_num);
                    }
                }

                gpio_pin_set_dt(&led0, 1);
            }
            else
            {
                // LOG_DBG("Ignoring packet with wrong length: %d (expected %d)",
                //         rx_payload.length, sizeof(controller_data_t));
            }
        }
        else
        {
            LOG_WRN("Failed to read RX payload");
        }
        
        // Monitor RX processing time
        uint32_t rx_process_time = k_uptime_get_32() - rx_start;
        if (rx_process_time > 2) { // Warn if RX processing takes over 2ms
            LOG_WRN("Slow RX processing: %dms", rx_process_time);
        }
        
        // Track time between RX processing - only warn on major delays
        if (last_rx_process_time != 0) {
            uint32_t rx_interval = rx_start - last_rx_process_time;
            if (rx_interval > 20) { // Only warn if > 20ms (was 8ms)
                LOG_WRN("Long RX interval: %dms", rx_interval);
            }
        }
        last_rx_process_time = rx_start;
        
        break;

    case ESB_EVENT_TX_SUCCESS:
        // Every 50th ACK transmission, log success to verify ACK payloads are going out
        static uint32_t ack_tx_counter = 0;
        if (++ack_tx_counter % 50 == 0) {
            LOG_INF("ACK payloads being transmitted successfully (count: %d)", ack_tx_counter);
        }
        break;

    case ESB_EVENT_TX_FAILED:
        LOG_WRN("Failed to send ACK payload - flushing TX queue");
        // For PRX, this usually means the queued ACK payload couldn't be sent
        // Flush the TX FIFO to clear any stuck payloads
        esb_flush_tx();
        break;

    default:
        LOG_WRN("Unknown ESB event: %d", event->evt_id);
        break;
    }
}

// Clock initialization (based on Nordic reference)
int clocks_start(void)
{
    int err;
    int res;
    struct onoff_manager *clk_mgr;
    struct onoff_client clk_cli;

    clk_mgr = z_nrf_clock_control_get_onoff(CLOCK_CONTROL_NRF_SUBSYS_HF);
    if (!clk_mgr)
    {
        LOG_ERR("Unable to get the Clock manager");
        return -ENXIO;
    }

    sys_notify_init_spinwait(&clk_cli.notify);

    err = onoff_request(clk_mgr, &clk_cli);
    if (err < 0)
    {
        LOG_ERR("Clock request failed: %d", err);
        return err;
    }

    do
    {
        err = sys_notify_fetch_result(&clk_cli.notify, &res);
        if (!err && res)
        {
            LOG_ERR("Clock could not be started: %d", res);
            return res;
        }
    } while (err);

    LOG_INF("HF clock started");
    return 0;
}

// Initialize ESB for ACK-based controller communication
int controller_esb_init(void)
{
    int err;

    LOG_INF("Dongle ESB initialization starting...");

    // Start clocks first (like Nordic reference)
    err = clocks_start();
    if (err)
    {
        LOG_ERR("Clock start failed: %d", err);
        return err;
    }

    // Initialize LED
    if (!gpio_is_ready_dt(&led0))
    {
        return -ENODEV;
    }
    gpio_pin_configure_dt(&led0, GPIO_OUTPUT_INACTIVE);

    // ESB configuration - PRX mode to receive controller data and send ACKs
    // Based on Nordic reference sample
    struct esb_config config = ESB_DEFAULT_CONFIG;
    config.protocol = ESB_PROTOCOL_ESB_DPL;
    config.mode = ESB_MODE_PRX; // Receiver mode to listen and send ACKs
    config.retransmit_delay = 1000;
    config.retransmit_count = 5;
    config.event_handler = simple_esb_event_handler;
    config.bitrate = ESB_BITRATE_2MBPS;
    config.selective_auto_ack = true; // Enable ACK for timing coordination
    config.use_fast_ramp_up = false;

    // Initialize ESB
    err = esb_init(&config);
    if (err)
    {
        LOG_ERR("ESB init failed: %d", err);
        return err;
    }

    // Set addresses - using same pattern as Nordic reference but matching controller
    uint8_t base_addr_0[4] = {0xE7, 0xE7, 0xE7, 0xE7}; // RIGHT controller base (pipe 0)
    uint8_t base_addr_1[4] = {0xD4, 0xD4, 0xD4, 0xD4}; // LEFT controller base (pipe 1)
    uint8_t addr_prefix[8] = {0xE7, 0xD4, 0xC3, 0xC4, 0xC5, 0xC6, 0xC7, 0xC8};

    err = esb_set_base_address_0(base_addr_0);
    if (err)
    {
        LOG_ERR("ESB set base address 0 failed: %d", err);
        return err;
    }

    err = esb_set_base_address_1(base_addr_1);
    if (err)
    {
        LOG_ERR("ESB set base address 1 failed: %d", err);
        return err;
    }

    err = esb_set_prefixes(addr_prefix, 8);
    if (err)
    {
        LOG_ERR("ESB set prefixes failed: %d", err);
        return err;
    }

    // Set RF channel
    err = esb_set_rf_channel(1);
    if (err)
    {
        LOG_ERR("ESB set RF channel failed: %d", err);
        return err;
    }

    // Set radio TX power to maximum
    err = esb_set_tx_power(ESB_TX_POWER_8DBM);
    if (err)
    {
        LOG_ERR("ESB set TX power failed: %d", err);
        return err;
    }

    LOG_INF("ESB configuration complete");

    // Write initial payload (like Nordic PRX reference does)
    struct esb_payload tx_payload = {0};
    tx_payload.length = 8;
    tx_payload.pipe = 0;
    tx_payload.data[0] = 0x10;
    tx_payload.data[1] = 0x11;

    err = esb_write_payload(&tx_payload);
    if (err)
    {
        LOG_ERR("Initial payload write failed: %d", err);
        return err;
    }

    LOG_INF("Setting up for packet reception");

    // Start receiving (like Nordic reference)
    err = esb_start_rx();
    if (err)
    {
        LOG_ERR("ESB start RX failed: %d", err);
        return err;
    }

    LOG_INF("ESB initialized for ACK-based communication - listening for controller data");
    return 0;
}

// Get current controller state
// Legacy function - returns right controller for backward compatibility
simple_controller_state_t *controller_esb_get_state(void)
{
    return &right_controller_state;
}

// Get left controller state
simple_controller_state_t *controller_esb_get_left_state(void)
{
    return &left_controller_state;
}

// Get right controller state
simple_controller_state_t *controller_esb_get_right_state(void)
{
    return &right_controller_state;
}

// Check if we have new data from either controller
bool controller_esb_has_new_data(void)
{
    // Consider data "new" if we received it within the last 100ms from either controller
    uint32_t now = k_uptime_get_32();
    bool left_has_data = left_controller_state.data_received &&
                        (now - left_controller_state.last_ping_time) < 100;
    bool right_has_data = right_controller_state.data_received &&
                         (now - right_controller_state.last_ping_time) < 100;
    return left_has_data || right_has_data;
}
```

## src/controller_esb.h
```c
#ifndef CONTROLLER_ESB_H
#define CONTROLLER_ESB_H

#include <zephyr/kernel.h>
#include <esb.h>

// Controller data structure - must match controller side
typedef struct
{
    uint8_t flags;   // Mode bits, controller ID, mouse buttons, trigger buttons
    uint8_t trigger;  // Analog trigger (L2/R2)
    int8_t stickX;   // Analog stick X
    int8_t stickY;   // Analog stick Y
    int16_t padX;    // Trackpad X (-32767 to 32767)
    int16_t padY;    // Trackpad Y (-32767 to 32767)
    uint8_t buttons; // Digital button states
    int16_t accelX;  // Accelerometer X
    int16_t accelY;  // Accelerometer Y
    int16_t accelZ;  // Accelerometer Z
    int16_t gyroX;   // Gyroscope X
    int16_t gyroY;   // Gyroscope Y
    int16_t gyroZ;   // Gyroscope Z
} __packed controller_data_t;

// ACK payload structure for timing control + rumble (lean design - 8 bytes total)
typedef struct
{
    uint16_t next_delay_ms;      // How long controller should wait before next transmission (0-65535ms)
    uint8_t sequence_num;        // Sequence tracking for debugging/sync
    uint8_t rumble_data;         // Rumble intensity: bits 7-4=left motor, bits 3-0=right motor (0-15 each)
    uint32_t dongle_timestamp;   // Dongle's current time for sync
} __packed ack_timing_data_t;

// Simple controller state for dongle
typedef struct
{
    uint8_t flags;
    uint8_t trigger;
    int8_t stickX;
    int8_t stickY;
    int16_t padX;
    int16_t padY;
    uint8_t buttons;
    int16_t accelX;
    int16_t accelY;
    int16_t accelZ;
    int16_t gyroX;
    int16_t gyroY;
    int16_t gyroZ;
    bool data_received;
    uint32_t last_ping_time;
} simple_controller_state_t;

// Function declarations
int controller_esb_init(void);
simple_controller_state_t *controller_esb_get_state(void);  // Legacy function - returns right controller
simple_controller_state_t *controller_esb_get_left_state(void);   // Get left controller state
simple_controller_state_t *controller_esb_get_right_state(void);  // Get right controller state
bool controller_esb_has_new_data(void);

#endif // CONTROLLER_ESB_H
```

## src/usb_hid_composite.h
```c
#ifndef USB_HID_COMPOSITE_H
#define USB_HID_COMPOSITE_H

#include <zephyr/kernel.h>
#include <zephyr/device.h>
#include <zephyr/usb/class/usb_hid.h>

// Report IDs
#define DS4_REPORT_ID     1
#define MOUSE_REPORT_ID   201
#define KEYBOARD_REPORT_ID 202

// Initialize USB HID composite device
int usb_hid_composite_init(void);

// Get the HID device handle
const struct device* usb_hid_composite_get_device(void);

// Helper function to send DS4 gamepad report with touchpad and IMU data
void usb_hid_send_ds4_report_with_touchpad_and_imu(const struct device *hid_dev, uint8_t dpad, uint8_t buttons1, uint8_t buttons2, 
                             uint8_t left_x, uint8_t left_y, uint8_t right_x, uint8_t right_y, 
                             uint8_t left_trigger, uint8_t right_trigger,
                             bool touch1_active, uint16_t touch1_x, uint16_t touch1_y,
                             bool touch2_active, uint16_t touch2_x, uint16_t touch2_y,
                             int16_t accel_x, int16_t accel_y, int16_t accel_z,
                             int16_t gyro_x, int16_t gyro_y, int16_t gyro_z);

// Helper function to send mouse report
void usb_hid_send_mouse_report(const struct device *hid_dev, int8_t x, int8_t y, int8_t wheel, uint8_t buttons);

// Helper function to send keyboard report  
void usb_hid_send_keyboard_report(const struct device *hid_dev, uint8_t modifiers, uint8_t key1, uint8_t key2, uint8_t key3, uint8_t key4, uint8_t key5, uint8_t key6);

#endif // USB_HID_COMPOSITE_H
```
